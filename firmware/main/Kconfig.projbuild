## firmware/main/Kconfig.projbuild
```kconfig
menu "Matter LED Ecosystem"

    config RUN_TESTS
        bool "Run Unit Tests"
        default n
        help
            If enabled, the application will run the registered unit tests
            instead of the main application logic.

endmenu
```

## firmware/sdkconfig.defaults
```kconfig
# Default configuration for Matter LED Ecosystem

# Target ESP32-S3
CONFIG_IDF_TARGET="esp32s3"

# Partition table
CONFIG_PARTITION_TABLE_CUSTOM=y
CONFIG_PARTITION_TABLE_CUSTOM_FILENAME="partitions.csv"

# Flash size
CONFIG_ESPTOOLPY_FLASHSIZE_4MB=y

# Enable Matter
CONFIG_ENABLE_CHIP_SHELL=y
CONFIG_CHIP_TASK_STACK_SIZE=8192

# Bluetooth (for Matter commissioning)
CONFIG_BT_ENABLED=y
CONFIG_BT_NIMBLE_ENABLED=y
CONFIG_BT_NIMBLE_50_FEATURE_SUPPORT=y

# Wi-Fi
CONFIG_ESP_WIFI_STATIC_RX_BUFFER_NUM=16
CONFIG_ESP_WIFI_DYNAMIC_RX_BUFFER_NUM=64
CONFIG_ESP_WIFI_STATIC_TX_BUFFER=y
CONFIG_ESP_WIFI_TX_BUFFER_TYPE=0
CONFIG_ESP_WIFI_STATIC_TX_BUFFER_NUM=16
CONFIG_ESP_WIFI_CACHE_TX_BUFFER_NUM=32

# LWIP
CONFIG_LWIP_IPV6=y
CONFIG_LWIP_IPV6_AUTOCONFIG=y
CONFIG_LWIP_MAX_SOCKETS=16

# mDNS
CONFIG_MDNS_MULTIPLE_INSTANCE=y

# FreeRTOS
CONFIG_FREERTOS_HZ=1000
CONFIG_FREERTOS_UNICORE=n

# LED Strip (RMT)
CONFIG_RMT_ISR_IRAM_SAFE=y

# Logging
CONFIG_LOG_DEFAULT_LEVEL_INFO=y
CONFIG_LOG_MAXIMUM_LEVEL_DEBUG=y

# Memory optimization
CONFIG_ESP_SYSTEM_EVENT_TASK_STACK_SIZE=4096
CONFIG_ESP_MAIN_TASK_STACK_SIZE=8192
CONFIG_COMPILER_OPTIMIZATION_SIZE=y

# Security
CONFIG_ESP_TLS_INSECURE=n
CONFIG_ESP_TLS_SKIP_SERVER_CERT_VERIFY=n

# NVS
CONFIG_NVS_ENCRYPTION=y

# OTA Updates
CONFIG_ESP_MATTER_OTA_ENABLE_OTA_REQUESTOR=y
CONFIG_ESP_MATTER_OTA_ENABLE_OTA_PROVIDER=n
CONFIG_APP_ROLLBACK_ENABLE=y

# Power Management
CONFIG_PM_ENABLE=y
CONFIG_PM_DFS_INIT_AUTO=y
CONFIG_ESP_WIFI_PM_ENABLE=y
CONFIG_FREERTOS_USE_TICKLESS_IDLE=y

# System Reliability
CONFIG_ESP_TASK_WDT_EN=y
CONFIG_ESP_TASK_WDT_TIMEOUT_S=10
CONFIG_ESP_TASK_WDT_CHECK_IDLE_TASK_CPU0=y
CONFIG_ESP_BROWNOUT_DET=y
CONFIG_ESP_BROWNOUT_DET_LVL_SEL_7=y
```
